// SPDX-License-Identifier: GPL-2.0-only
// Generated by panel_sequence.py from the stock board overlay: the panels' commands.

&display_panel {
	pico4,on-command = [29 01 00 00 00 00 02 b0 00 29 01 00 00 00 00 05 b9 13 5f 02 64 29 01 00 00 00 00 03 ec 06 48 29 01 00 00 00 00 03 ec 05 d8 29 01 00 00 00 00 02 d6 00 29 01 00 00 00 00 02 d2 0e 29 01 00 00 00 00 03 be 00 0d 29 01 00 00 00 00 02 f1 18 29 01 00 00 00 00 05 d1 09 30 03 09 29 01 00 00 00 00 02 f1 1a 29 01 00 00 00 00 02 c2 07 29 01 00 00 00 00 02 f1 08 29 01 00 00 00 00 02 b6 60 29 01 00 00 00 00 81 e6 11 00 00 89 30 80 08 70 08 70 00 10 02 1c 02 1c 02 00 02 0e 00 20 01 84 00 07 00 0c 06 67 06 5c 18 00 10 f0 03 0c 20 00 06 0b 0b 33 0e 1c 2a 38 46 54 62 69 70 77 79 7b 7d 7e 01 02 01 00 09 40 09 be 19 fc 19 fa 19 f8 1a 38 1a 78 1a b6 2a f6 2b 34 2b 74 3b 74 6b f4 00 00 00 00 00 00 00 00 00 00 00 00 00 00 00 00 00 00 00 00 00 00 00 00 00 00 00 00 00 00 00 00 00 00 00 00 00 00 00 00 39 01 00 00 00 00 02 35 00 39 01 00 00 00 00 02 36 01 39 01 00 00 00 00 02 26 01 39 01 00 00 00 00 02 03 01 05 01 00 00 78 00 01 11 05 01 00 00 78 00 01 29];
	pico4,off-command = [05 01 00 00 32 00 02 28 00 05 01 00 00 78 00 02 10 00];
};
